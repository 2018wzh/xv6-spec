## hardware/visionfive2/xv6.its
```
/dts-v1/;

/ {
  description = "xv6-spec VisionFive 2 S-mode kernel";
  #address-cells = <2>;

  images {
    kernel {
      description = "xv6 S-mode kernel";
      data = /incbin/("../../build/kernel-vf2.bin");
      type = "kernel";
      arch = "riscv";
      os = "linux";
      compression = "none";
      load = <0x0 0x40200000>;
      entry = <0x0 0x40200000>;
      hash-1 { algo = "sha256"; };
    };

    fdt {
      description = "VisionFive 2 VF2_v3.8.2 device tree";
      data = /incbin/("../../build/visionfive2.dtb");
      type = "flat_dt";
      arch = "riscv";
      compression = "none";
      hash-1 { algo = "sha256"; };
    };
  };

  configurations {
    default = "xv6-visionfive2";
    xv6-visionfive2 {
      description = "xv6 on StarFive VisionFive 2";
      kernel = "kernel";
      fdt = "fdt";
    };
  };
};
```
